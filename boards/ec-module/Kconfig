## boards/ec-module/Kconfig
```kconfig
# Copyright (c) 2020 Inria
#
# This file is subject to the terms and conditions of the GNU Lesser
# General Public License v2.1. See the file LICENSE in the top level
# directory for more details.
#

config BOARD
    default "ec-module" if BOARD_EC_MODULE

config BOARD_EC_MODULE
    bool
    default y
    select CPU_MODEL_STM32L010C6

source "$(RIOTBOARD)/common/stm32/Kconfig"
```
